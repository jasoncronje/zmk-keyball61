## config/boards/shields/keyball61_ble/Kconfig.defconfig
```kconfig
if SHIELD_KEYBALL61_BLE_RIGHT

config ZMK_KEYBOARD_NAME
	default "Keyball61 BLE"

config ZMK_SPLIT_ROLE_CENTRAL
	default y

endif

if SHIELD_KEYBALL61_BLE_LEFT || SHIELD_KEYBALL61_BLE_RIGHT

config ZMK_SPLIT
	default y

endif
```

## config/boards/shields/keyball61_ble/Kconfig.shield
```kconfig
config SHIELD_KEYBALL61_BLE_LEFT
    def_bool $(shields_list_contains,keyball61_ble_left)

config SHIELD_KEYBALL61_BLE_RIGHT
    def_bool $(shields_list_contains,keyball61_ble_right)
```

## config/boards/shields/keyball61_nv/Kconfig.defconfig
```kconfig
if SHIELD_KEYBALL61_NV_RIGHT

config ZMK_KEYBOARD_NAME
	default "Keyball61"

config ZMK_SPLIT_ROLE_CENTRAL
	default y

endif

if SHIELD_KEYBALL61_NV_LEFT || SHIELD_KEYBALL61_NV_RIGHT

config ZMK_SPLIT
	default y

endif
```

## config/boards/shields/keyball61_nv/Kconfig.shield
```kconfig
config SHIELD_KEYBALL61_NV_LEFT
    def_bool $(shields_list_contains,keyball61_nv_left)

config SHIELD_KEYBALL61_NV_RIGHT
    def_bool $(shields_list_contains,keyball61_nv_right)
```

## modules/Kconfig
```kconfig
rsource "touchid-power/Kconfig"
rsource "status-screen/Kconfig"
rsource "keylog/Kconfig"
```

## modules/dts/bindings/behaviors/zmk,behavior-layer-sync.yaml
```yaml
description: |
  Hands the active layer's name to the left half for its status screen. Not
  for keymaps: the right half's status screen invokes it on each layer change,
  with the name packed into both params.

compatible: "zmk,behavior-layer-sync"

include: two_param.yaml
```

## modules/dts/bindings/behaviors/zmk,behavior-touchid.yaml
```yaml
description: Sets the left half's Touch ID power mode (auto, on or off)

compatible: "zmk,behavior-touchid"

include: one_param.yaml
```

## modules/keylog/Kconfig
```kconfig
config KEYBALL61_KEYLOG
	bool "Stream key positions, keycodes and layers to the host over Raw HID"
	default y
	depends on RAW_HID
	help
	  For tools/keylog on the Mac. Streams only while the host keeps renewing
	  its start command, so nothing goes out when the logger isn't running.
	  On by default wherever Raw HID is (the raw_hid_adapter shield).

config KEYBALL61_KEYLOG_BUFFER
	int "Records held while waiting for the host link"
	default 96
	depends on KEYBALL61_KEYLOG

config KEYBALL61_KEYLOG_FLUSH_MS
	int "Longest wait before a partly filled report is sent (ms)"
	default 30
	depends on KEYBALL61_KEYLOG
	help
	  Records go out three per report. Waiting a little fills more reports,
	  so the logger takes fewer host link slots away from the trackball.

config KEYBALL61_KEYLOG_LEASE_MS
	int "How long one start command keeps streaming on (ms)"
	default 10000
	depends on KEYBALL61_KEYLOG
```

## modules/status-screen/Kconfig
```kconfig
config KEYBALL61_STATUS_SCREEN
	bool "Keyball61 status screen"
	depends on ZMK_DISPLAY && ZMK_DISPLAY_STATUS_SCREEN_CUSTOM
	select LV_USE_IMG
	select LV_USE_CANVAS
	help
	  Draws both halves' displays in labelled blocks, read in portrait.
	  The right half shows both batteries, the output, the active layer and the
	  held modifiers; the left half shows its battery, its link to the right
	  half and Touch ID. Replaces zmk-nice-oled's widgets on the OLEDs (set
	  CONFIG_NICE_OLED_WIDGET_STATUS=n alongside it) and ZMK's nice!view
	  widget (set CONFIG_NICE_VIEW_WIDGET_STATUS=n).

config KEYBALL61_STATUS_SCREEN_NICE_VIEW
	bool "Lay the status screen out for a 160x68 nice!view"
	depends on KEYBALL61_STATUS_SCREEN
	default y if SHIELD_NICE_VIEW
	help
	  Uses layout_nice_view.c, read in portrait (68x160), instead of the
	  128x32 OLED layout.
```

## modules/touchid-power/Kconfig
```kconfig
config KEYBALL61_TOUCHID_POWER
	bool "Switch the Touch ID boost converter off when the keyboard is idle"
	depends on GPIO
	help
	  Drives the boost converter's En pin from the zephyr,user touchid-en-gpios
	  property: on while the keyboard is active, off a while after it goes idle.
	  Plugging in USB switches to always-on until it's unplugged, and the
	  &touchid behavior picks auto, always-on or off from the keymap.

config KEYBALL61_TOUCHID_OFF_DELAY_SEC
	int "Seconds after the keyboard goes idle before Touch ID is switched off"
	default 270
	depends on KEYBALL61_TOUCHID_POWER
	help
	  Counted from ZMK's idle state (CONFIG_ZMK_IDLE_TIMEOUT, 30 s by default),
	  so the default switches Touch ID off about 5 minutes after the last key press.

config KEYBALL61_TOUCHID_DISPLAY_ICON
	bool "Show a fingerprint on the peripheral OLED, crossed out while Touch ID is off"
	default y
	depends on KEYBALL61_TOUCHID_POWER && ZMK_DISPLAY && NICE_OLED_WIDGET_STATUS
	depends on ZMK_SPLIT && !ZMK_SPLIT_ROLE_CENTRAL
	help
	  Draws through zmk-nice-oled's nice_oled_draw_peripheral_extras() hook, at the
	  bottom of the portrait canvas.

config KEYBALL61_TOUCHID_ICON_CENTER_Y
	int "Fingerprint icon centre, in portrait canvas rows"
	default 143
	depends on KEYBALL61_TOUCHID_DISPLAY_ICON
	help
	  The nice_oled 128x32 panel shows rows 32-159 of the 160-row portrait canvas,
	  so the default sits the 29 px icon at the bottom of the screen.
```
